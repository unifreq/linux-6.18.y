## drivers/net/wireless/realtek/rtl8189fs/Kconfig
```kconfig
# SPDX-License-Identifier: GPL-2.0
#
# Realtek RTL8189FS SDIO WiFi driver (vendor driver, no mainline equivalent)
#
config RTL8189FS
	tristate "Realtek 8189FS SDIO WiFi"
	depends on CFG80211 && MMC
	help
	  Say Y here to include the Realtek RTL8189FS 802.11n SDIO
	  wireless driver.  The chip has no mainline driver -- rtl8xxxu
	  and rtw88 cover the USB/PCIe parts only -- so boards built
	  around it, such as the Allwinner H616 TV boxes, need this
	  vendor driver.

	  To compile this driver as a module, choose M here: the module
	  will be called 8189fs.
```
