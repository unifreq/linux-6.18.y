## Documentation/devicetree/bindings/mmc/amlogic,meson-gx-mmc.yaml
```yaml
# SPDX-License-Identifier: (GPL-2.0-only OR BSD-2-Clause)
%YAML 1.2
---
$id: http://devicetree.org/schemas/mmc/amlogic,meson-gx-mmc.yaml#
$schema: http://devicetree.org/meta-schemas/core.yaml#

title: Amlogic SD / eMMC controller for S905/GXBB family SoCs

description:
  The MMC 5.1 compliant host controller on Amlogic provides the
  interface for SD, eMMC and SDIO devices

maintainers:
  - Neil Armstrong <neil.armstrong@linaro.org>

allOf:
  - $ref: mmc-controller.yaml#
  - if:
      properties:
        compatible:
          contains:
            const: amlogic,t7-mmc
    then:
      properties:
        clocks:
          minItems: 4
        clock-names:
          minItems: 4
    else:
      properties:
        clocks:
          maxItems: 3
        clock-names:
          maxItems: 3

properties:
  compatible:
    oneOf:
      - items:
          - enum:
              - amlogic,t7-mmc
          - const: amlogic,meson-axg-mmc
      - const: amlogic,meson-axg-mmc
      - items:
          - const: amlogic,meson-gx-mmc
          - const: amlogic,meson-gxbb-mmc

  reg:
    maxItems: 1

  interrupts:
    minItems: 1
    items:
      - description: mmc controller instance
      - description: card detect

  clocks:
    minItems: 3
    items:
      - description: core clock
      - description: clock input 0 of the internal mux
      - description: clock input 1 of the internal mux
      - description:
          clock of the pipeline stage inserted in the bus path between
          the controller and the DRAM. Without it, the controller cannot
          complete DMA transfers.

  clock-names:
    minItems: 3
    items:
      - const: core
      - const: clkin0
      - const: clkin1
      - const: pipeline

  resets:
    maxItems: 1

  amlogic,dram-access-quirk:
    type: boolean
    description:
      set when controller's internal DMA engine cannot access the DRAM memory,
      like on the G12A dedicated SDIO controller.

  power-domains:
    maxItems: 1

  pinctrl-names:
    description: |
      "default" and the optional "clk-gate" state, which keeps the clock
      pad low while the clock is gated. A controller with slot nodes also
      has a "slotN" state that connects slot N to the controller, and an
      optional "slotN-clk-gate" state.

patternProperties:
  "^slot@[01]$":
    $ref: mmc-slot.yaml#
    description:
      A card slot. Without slot nodes the controller node describes its
      only slot. With slot nodes, each enabled slot gets its own MMC host
      and the slots take turns on the controller, which reaches the card
      of a slot through the pins of its "slotN" pinctrl state.
    properties:
      reg:
        maximum: 1

    required:
      - compatible

required:
  - compatible
  - reg
  - interrupts
  - clocks
  - clock-names
  - resets

unevaluatedProperties: false

examples:
  - |
    #include <dt-bindings/interrupt-controller/irq.h>
    #include <dt-bindings/interrupt-controller/arm-gic.h>
    mmc@70000 {
        compatible = "amlogic,meson-gx-mmc", "amlogic,meson-gxbb-mmc";
        reg = <0x70000 0x2000>;
        interrupts = <GIC_SPI 216 IRQ_TYPE_EDGE_RISING>;
        clocks = <&clk_mmc>, <&xtal>, <&clk_div>;
        clock-names = "core", "clkin0", "clkin1";
        pinctrl-0 = <&emm_pins>;
        resets = <&reset_mmc>;
    };

  - |
    #include <dt-bindings/interrupt-controller/irq.h>
    #include <dt-bindings/interrupt-controller/arm-gic.h>
    mmc@ffe05000 {
        compatible = "amlogic,meson-axg-mmc";
        reg = <0xffe05000 0x800>;
        interrupts = <GIC_SPI 190 IRQ_TYPE_EDGE_RISING>;
        clocks = <&clk_mmc>, <&xtal>, <&clk_div>;
        clock-names = "core", "clkin0", "clkin1";
        resets = <&reset_mmc>;
        pinctrl-0 = <&sdio_pins>;
        pinctrl-1 = <&sdcard_pins>;
        pinctrl-2 = <&sdcard_clk_gate_pins>;
        pinctrl-3 = <&sdio_pins>;
        pinctrl-4 = <&sdio_clk_gate_pins>;
        pinctrl-names = "default", "slot0", "slot0-clk-gate", "slot1",
                        "slot1-clk-gate";
        #address-cells = <1>;
        #size-cells = <0>;

        slot@0 {
            compatible = "mmc-slot";
            reg = <0>;
            bus-width = <4>;
            cap-sd-highspeed;
            max-frequency = <50000000>;
        };

        slot@1 {
            compatible = "mmc-slot";
            reg = <1>;
            bus-width = <4>;
            cap-sdio-irq;
            non-removable;
            max-frequency = <100000000>;
        };
    };
```
